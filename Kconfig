## Kconfig
```kconfig
#
# For a description of the syntax of this configuration file,
# see kconfig-language at https://www.kernel.org/doc/Documentation/kbuild/kconfig-language.txt
#

config ENABLE_RT_OCF
	bool "RT-OCF Framework"
	default y
	---help---
			Enable/Disable D2D Framework based on OCF

if ENABLE_RT_OCF
source "$EXTERNALDIR/RT-OCF/os/linux/OCF_Kconfig"
endif
```
